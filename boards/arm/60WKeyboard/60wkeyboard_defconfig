## boards/arm/60WKeyboard/60wkeyboard_defconfig
```kconfig
# Board Identity
CONFIG_BOARD_60WKEYBOARD=y

# Hardware Architecture
CONFIG_ARM_MPU=y
CONFIG_PINCTRL=y
CONFIG_GPIO=y

# Bootloader & Flash Settings
CONFIG_USE_DT_CODE_PARTITION=y
CONFIG_BUILD_OUTPUT_UF2=y
CONFIG_MPU_ALLOW_FLASH_WRITE=y
CONFIG_NVS=y
CONFIG_SETTINGS_NVS=y
CONFIG_FLASH=y
CONFIG_FLASH_PAGE_LAYOUT=y
CONFIG_FLASH_MAP=y

# Keyboard Matrix & Features
CONFIG_ZMK_KEYBOARD_NAME="60W Keyboard"
CONFIG_ZMK_USB=y
CONFIG_ZMK_BLE=y

# Per-Key RGB Settings (Using Underglow drivers)
CONFIG_ZMK_RGB_UNDERGLOW=y
CONFIG_WS2812_STRIP=y
CONFIG_SPI=y

# Default RGB Effects
CONFIG_ZMK_RGB_UNDERGLOW_HUE_START=160
CONFIG_ZMK_RGB_UNDERGLOW_SAT_START=100
CONFIG_ZMK_RGB_UNDERGLOW_BRT_START=10
CONFIG_ZMK_RGB_UNDERGLOW_EFF_START=3

# Power Management
# Disable DCDC because custom boards without specific inductors will crash if enabled
CONFIG_SOC_DCDC_NRF52X=n
# Enable Sleep mode to save battery
CONFIG_ZMK_SLEEP=y
CONFIG_ZMK_IDLE_SLEEP_TIMEOUT=900000

# USB Power Output (Required for some USB-C to USB-C cables)
CONFIG_USB_DEVICE_STACK=y
CONFIG_USB_DEVICE_PRODUCT="60W Keyboard"
```

## boards/arm/60WKeyboard/Kconfig
```kconfig
config BOARD_60WKEYBOARD
    bool "60wkeyboard"
    depends on SOC_NRF52840_QIAA
```

## boards/arm/60wkeyboard/60wkeyboard_defconfig
```kconfig
CONFIG_SOC_SERIES_NRF52X=y
CONFIG_SOC_NRF52840_QIAA=y
CONFIG_BOARD_60WKEYBOARD=y

# ARM
CONFIG_ARM_MPU=y
CONFIG_MPU_ALLOW_FLASH_WRITE=y

# Pin control
CONFIG_PINCTRL=y

# GPIO
CONFIG_GPIO=y

# Flash / Storage
CONFIG_FLASH=y
CONFIG_FLASH_PAGE_LAYOUT=y
CONFIG_FLASH_MAP=y
CONFIG_NVS=y
CONFIG_SETTINGS_NVS=y

# UF2 bootloader output
CONFIG_USE_DT_CODE_PARTITION=y
CONFIG_BUILD_OUTPUT_UF2=y

# USB — both layers required
CONFIG_USB_DEVICE_STACK=y
CONFIG_ZMK_USB=y

# Bluetooth — both layers required
CONFIG_BT=y
CONFIG_ZMK_BLE=y

# RGB disabled for base build
CONFIG_ZMK_RGB_UNDERGLOW=n
CONFIG_WS2812_STRIP=n
```

## boards/arm/60wkeyboard/Kconfig.60wkeyboard
```kconfig
# Copyright (c) 2021 Nick Winans
# SPDX-License-Identifier: Apache-2.0

config BOARD_60WKEYBOARD
    select SOC_NRF52840_QIAA
```

## boards/arm/60wkeyboard/Kconfig.board
```kconfig
config BOARD_60WKEYBOARD
    bool "60wkeyboard"
	depends on SOC_NRF52840_QIAA
    select SOC_SERIES_NRF52X
    select HAS_NRFX
```

## boards/arm/60wkeyboard/Kconfig.defconfig
```kconfig
if BOARD_60WKEYBOARD

config ZMK_KEYBOARD_NAME
    default "60wkeyboard"

if USB_DEVICE_STACK

config USB_NRFX
    default y

config USB_DEVICE_PRODUCT
    default "60wkeyboard"

config USB_DEVICE_VID
    default 0x1d50

config USB_DEVICE_PID
    default 0x615e

endif # USB_DEVICE_STACK

config BT_CTLR
    default y
    depends on BT

endif # BOARD_60WKEYBOARD
```

## boards/arm/60wkeyboard/board.yml
```yaml
board:
  name: 60wkeyboard
  vendor: dac63701
  socs:
    - name: nrf52840
      variants:
        - name: zmk
```

## boards/shields/60wkeyboard/Kconfig.defconfig
```kconfig
if SHIELD_60WKEYBOARD

config ZMK_KEYBOARD_NAME
    default "60wkeyboard"

endif
```
